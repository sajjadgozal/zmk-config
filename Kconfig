## Kconfig
```kconfig
rsource "drivers/input/Kconfig.analog_joystick"
rsource "src/Kconfig.endpoint_layer"
```

## boards/shields/media_controller/Kconfig.shield
```kconfig
config SHIELD_MEDIA_CONTROLLER
    def_bool $(shields_list_contains,media_controller)
```

## drivers/input/Kconfig.analog_joystick
```kconfig
config INPUT_ANALOG_JOYSTICK
    bool "Analog joystick input driver"
    default y
    depends on DT_HAS_ZMK_ANALOG_JOYSTICK_ENABLED
    select ADC
    select INPUT
    help
      Two-axis analog joystick (e.g. a salvaged PS5 controller thumbstick)
      read via ADC and reported as relative mouse-movement input events.
```

## dts/bindings/input/zmk,analog-joystick.yaml
```yaml
description: |
  Two-axis analog joystick (e.g. a salvaged PS5 controller thumbstick)
  reporting relative mouse-movement input events proportional to
  deflection from center, like a trackpoint.

compatible: "zmk,analog-joystick"

include: base.yaml

properties:
  io-channels:
    type: phandle-array
    required: true
    description: |
      ADC channels for the joystick axes, X first then Y.
      Example: io-channels = <&adc 0>, <&adc 1>;

  deadzone:
    type: int
    default: 150
    description: |
      Minimum deflection, in raw ADC counts, from the resting center
      position before any movement is reported. Increase if the cursor
      drifts at rest.

  max-speed:
    type: int
    default: 1200
    description: |
      Mouse-mode cursor speed, in pixels per second, at full deflection.

  expo:
    type: int
    default: 60
    description: |
      Mouse-mode response curve, 0-100. Speed = (1 - e)*t + e*t^2 of
      max-speed, where t is deflection past the deadzone (0..1) and
      e = expo/100. 0 = linear (small tilts faster), 100 = quadratic
      (more precision near center, slower small tilts).

  smoothing-ms:
    type: int
    default: 40
    description: |
      Mouse-mode velocity smoothing time constant. Speed and direction
      changes ease in over roughly this long instead of following every
      stick jitter. 0 disables. Higher = smoother but less immediate.

  full-deflection:
    type: int
    default: 1400
    description: |
      Starting guess, in raw ADC counts from center, for the deflection
      that means full tilt (max-speed). The driver raises it
      automatically to the largest deflection the stick actually
      produces, so it only needs to be no larger than the stick's real
      travel.

  poll-interval-ms:
    type: int
    default: 10
    description: |
      How often to sample the joystick and report movement while it's
      being tilted (or an arrow key is held).

  idle-poll-interval-ms:
    type: int
    default: 30
    description: |
      Slower sampling interval used while the stick is at rest, to save
      power. Also bounds the extra latency before movement starts.

  arrow-layer:
    type: int
    default: 1
    description: |
      ZMK keymap layer index. While this layer is active, the joystick
      reports arrow-key presses (held while tilted past the deadzone,
      released when centered) instead of relative mouse movement.
```

## src/Kconfig.endpoint_layer
```kconfig
config ZMK_ENDPOINT_LAYER
    bool "Activate a keymap layer while a given BLE profile is the active output"
    depends on ZMK_BLE
    help
      Keeps keymap layer ZMK_ENDPOINT_LAYER_INDEX active exactly while
      the device is outputting over BLE profile ZMK_ENDPOINT_LAYER_PROFILE,
      and inactive on every other profile and over USB. Lets a button
      do something different per host (e.g. media prev/next on a Mac,
      Android TV navigation keys on a TV).

if ZMK_ENDPOINT_LAYER

config ZMK_ENDPOINT_LAYER_PROFILE
    int "BLE profile index that activates the layer"
    default 1

config ZMK_ENDPOINT_LAYER_INDEX
    int "Keymap layer index to activate"
    default 2

endif
```
